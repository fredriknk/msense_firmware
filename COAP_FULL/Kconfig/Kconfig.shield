## COAP_FULL/Kconfig/Kconfig.shield
```kconfig
osource "c:/users/fnk/documents/github/nrfboards/boards/shields/*/Kconfig.shield"
osource "c:/ncs/workspace_1/nrf_cloud_multi_service_2/boards/shields/*/Kconfig.shield"
osource "C:/ncs/v2.7.0/nrf/boards/shields/*/Kconfig.shield"
```

## MQTT_MIN/mcuboot/Kconfig/Kconfig.shield.defconfig
```kconfig
osource "c:/users/fnk/documents/github/nrfboards/boards/shields/*/Kconfig.defconfig"
osource "c:/ncs/workspace_1/nrf_cloud_multi_service_2/boards/shields/*/Kconfig.defconfig"
osource "C:/ncs/v2.7.0/nrf/boards/shields/*/Kconfig.defconfig"
```
